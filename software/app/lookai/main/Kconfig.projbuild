## software/app/lookai/main/Kconfig.projbuild
```kconfig
menu "LookAI"

    config LOOKAI_STT_API_KEY
        string "STT API key"
        default ""
        help
            API key used by the LookAI STT client.
            For OpenAI, paste your OpenAI API key here.
            Keep this private. Do not print this value in logs.

    config LOOKAI_STT_ENDPOINT
        string "STT endpoint"
        default "https://api.openai.com/v1/audio/transcriptions"
        help
            Audio transcription endpoint.
            Default value uses OpenAI's transcription endpoint.

    config LOOKAI_STT_MODEL
        string "STT model"
        default "gpt-4o-mini-transcribe"
        help
            Audio transcription model used by the STT API client.
            For OpenAI, use gpt-4o-mini-transcribe for low-cost tests or
            gpt-4o-transcribe for higher quality.

    config LOOKAI_STT_LANGUAGE
        string "STT language code"
        default "tr"
        help
            Optional ISO-639-1 language code for the input audio.
            Use an empty value to let the API auto-detect the language.


    config LOOKAI_AI_API_KEY
        string "AI API key"
        default ""
        help
            Optional API key used by the LookAI AI prompt client.
            Leave empty to reuse LOOKAI_STT_API_KEY for OpenAI.

    config LOOKAI_AI_ENDPOINT
        string "AI endpoint"
        default "https://api.openai.com/v1/chat/completions"
        help
            Chat/prompt endpoint used by the AI assistant.
            Default value uses OpenAI's chat completions endpoint.

    config LOOKAI_AI_MODEL
        string "AI model"
        default "gpt-4o-mini"
        help
            Text model used by the AI assistant prompt client.

    config LOOKAI_AI_SYSTEM_PROMPT
        string "AI system prompt"
        default "Kisa, net ve Turkce cevap ver. Sesli okunacagi icin en fazla 2-3 cumle kullan."
        help
            System prompt sent before the recognized user speech.
            Keep responses short so TTS can start quickly.

    config LOOKAI_AI_MAX_TOKENS
        int "AI max output tokens"
        default 160
        range 32 512
        help
            max_tokens value sent to the OpenAI-compatible chat endpoint.

    config LOOKAI_AI_MAX_OUTPUT_CHARS
        int "AI max output characters"
        default 600
        range 64 760
        help
            Local character limit copied from the AI response before TTS.
            Keep this under the TTS client's input limit.

    config LOOKAI_TTS_API_KEY
        string "TTS API key"
        default ""
        help
            Optional API key used by the LookAI TTS client.
            Leave empty to reuse LOOKAI_STT_API_KEY for OpenAI.

    config LOOKAI_TTS_ENDPOINT
        string "TTS endpoint"
        default "https://api.openai.com/v1/audio/speech"
        help
            Text-to-speech endpoint.
            Default value uses OpenAI's speech endpoint.

    config LOOKAI_TTS_MODEL
        string "TTS model"
        default "gpt-4o-mini-tts"
        help
            Text-to-speech model used by the TTS API client.
            For OpenAI, use gpt-4o-mini-tts for instruction-aware speech,
            or tts-1 / tts-1-hd if you intentionally select those models.

    config LOOKAI_TTS_VOICE
        string "TTS voice"
        default "marin"
        help
            Voice ID used by the TTS API client.
            OpenAI voices include marin, cedar, alloy, ash, ballad, coral,
            echo, fable, nova, onyx, sage, shimmer, and verse.

    choice LOOKAI_STT_AUDIO_FORMAT
        prompt "STT audio upload format"
        default LOOKAI_STT_AUDIO_FORMAT_WAV
        help
            Select the audio container used by the STT recorder and multipart
            upload. WAV is the safest OpenAI-compatible option. PCM is raw
            16 kHz, 16-bit, mono audio and is useful for compatible endpoints
            or experiments.

    config LOOKAI_STT_AUDIO_FORMAT_WAV
        bool "wav - record WAV and upload audio/wav"
        help
            Save /spiffs/stt_last.wav and upload it as audio/wav.

    config LOOKAI_STT_AUDIO_FORMAT_PCM
        bool "pcm - record raw PCM and upload audio/pcm"
        help
            Save /spiffs/stt_last.pcm and upload raw 16 kHz, 16-bit, mono PCM.

    endchoice

    choice LOOKAI_TTS_RESPONSE_FORMAT
        prompt "TTS response format"
        default LOOKAI_TTS_RESPONSE_FORMAT_WAV
        help
            Select how generated speech is requested and played.

    config LOOKAI_TTS_RESPONSE_FORMAT_WAV
        bool "wav - full download then playback"
        help
            Request response_format=wav, save /spiffs/tts_last.wav, then play
            the downloaded WAV file. This is the safer fallback path.

    config LOOKAI_TTS_RESPONSE_FORMAT_PCM
        bool "pcm - direct circular-buffer streaming"
        help
            Request response_format=pcm and play raw 24 kHz, 16-bit, mono PCM
            directly from the circular streaming buffer. No TTS WAV file is
            written.

    endchoice


endmenu

menu "LookAI diagnostics"

    config LOOKAI_RUNTIME_DIAG_ENABLE
        bool "Enable runtime heap/stack/timing logs"
        default n
        help
            Enable verbose runtime diagnostics. Keep this disabled for normal
            use because heap snapshots, stack high-water-mark checks, and
            serial logging add CPU load and can reduce UI/audio smoothness.

    config LOOKAI_DISPLAY_DIAG
        bool "Enable LVGL render/flush sample logs"
        default n
        depends on LOOKAI_RUNTIME_DIAG_ENABLE
        help
            Log 1-second LVGL render/flush/invalid-area samples. Useful while
            tuning the display, but it adds event callbacks and UART traffic.

    config LOOKAI_RUNTIME_DIAG_STACK_REPORT
        bool "Log FreeRTOS task stack report"
        default n
        depends on LOOKAI_RUNTIME_DIAG_ENABLE
        select FREERTOS_USE_TRACE_FACILITY
        help
            Create a low-priority diagnostics task that logs every live
            FreeRTOS task's stack high-water mark periodically.

    config LOOKAI_RUNTIME_DIAG_STACK_REPORT_INTERVAL_MS
        int "FreeRTOS task stack report interval (ms)"
        default 1000
        range 250 60000
        depends on LOOKAI_RUNTIME_DIAG_STACK_REPORT
        help
            Period between full task stack reports. 1000 ms gives a 1-second
            report cadence while debugging RAM/stack pressure.

    config LOOKAI_RUNTIME_DIAG_STACK_REPORT_MAX_TASKS
        int "FreeRTOS task stack report max tasks"
        default 32
        range 8 128
        depends on LOOKAI_RUNTIME_DIAG_STACK_REPORT
        help
            Maximum number of tasks captured in one report. Increase this if
            the log says task_stack_report_truncated.

    config LOOKAI_RUNTIME_DIAG_STACK_REPORT_TASK_STACK_BYTES
        int "FreeRTOS task stack report task stack size (bytes)"
        default 3072
        range 2048 8192
        depends on LOOKAI_RUNTIME_DIAG_STACK_REPORT
        help
            Stack allocated for the diagnostics task itself.

    config LOOKAI_RUNTIME_DIAG_STACK_REPORT_PRIORITY
        int "FreeRTOS task stack report task priority"
        default 1
        range 0 5
        depends on LOOKAI_RUNTIME_DIAG_STACK_REPORT
        help
            Diagnostics task priority. Keep this low to avoid affecting UI,
            audio, Wi-Fi, STT, and TTS tasks.

    config LOOKAI_RUNTIME_DIAG_STACK_LOW_WARN_BYTES
        int "FreeRTOS low stack warning threshold (bytes)"
        default 1024
        range 128 8192
        depends on LOOKAI_RUNTIME_DIAG_STACK_REPORT
        help
            Task stack high-water marks at or below this threshold are logged
            as warnings and marked LOW.

endmenu
```
